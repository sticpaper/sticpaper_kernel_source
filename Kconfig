## drivers/input/fingerprint/goodix_psyche/Kconfig
```kconfig
config FINGERPRINT_GOODIX_FOD_PSY
	tristate "Finger print card goodix"
	depends on INPUT_FINGERPRINT
```

## drivers/input/touchscreen/hxchipset/Kconfig
```kconfig
# Himax Touchscreen driver configuration

config TOUCHSCREEN_HIMAX_COMMON
	tristate "HIMAX chipset i2c touchscreen"
	depends on TOUCHSCREEN_HIMAX_CHIPSET
	help
	  This enables support for HIMAX CHIPSET touchscreens.

choice
	prompt "HIMAX touch IC types"
	depends on TOUCHSCREEN_HIMAX_COMMON
	default TOUCHSCREEN_HIMAX_INCELL

config TOUCHSCREEN_HIMAX_ONCELL
	bool "HIMAX chipset on-cell function"
	depends on TOUCHSCREEN_HIMAX_COMMON
	help
	  This enables support for HIMAX CHIPSET of on-cell function.

config TOUCHSCREEN_HIMAX_INCELL
	bool "HIMAX chipset in-cell function"
	depends on TOUCHSCREEN_HIMAX_COMMON
	help
	  This enables support for HIMAX CHIPSET of in-cell function.
endchoice

config TOUCHSCREEN_HIMAX_IC_HX83121
	tristate "HIMAX chipset HX83121 function"
	depends on TOUCHSCREEN_HIMAX_INCELL
	help
	  This enables support for HIMAX CHIPSET of HX83121.

config TOUCHSCREEN_HIMAX_DEBUG
	bool "HIMAX debug function"
	depends on TOUCHSCREEN_HIMAX_INCELL || TOUCHSCREEN_HIMAX_ONCELL
	help
	  This enables support for HIMAX debug function.

config TOUCHSCREEN_HIMAX_INSPECT
	bool "HIMAX inspect function"
	depends on TOUCHSCREEN_HIMAX_INCELL || TOUCHSCREEN_HIMAX_ONCELL
	help
	  This enables support for HIMAX inspect function.

config TOUCHSCREEN_HIMAX_EMBEDDED_FIRMWARE
	bool "HIMAX embedded firmware function"
	depends on TOUCHSCREEN_HIMAX_INCELL || TOUCHSCREEN_HIMAX_ONCELL
	help
	  This enables built-in FW inside kernel as binary array

config HMX_DB
	bool "HIMAX driver test over Dragon Board"
	depends on TOUCHSCREEN_HIMAX_COMMON
	help
	  This enables support for HIMAX driver test over Dragon Board.

config HIMAX_SUPPORT_KERNEL_419
	bool "HIMAX support kernel 4.19"
	depends on TOUCHSCREEN_HIMAX_COMMON
	help
	  This enables support for support kernel 4.19.
```

## drivers/mihw/Kconfig
```kconfig
config MIHW
	bool "Xiaomi Kernel Feature config"
	depends on ARCH_QCOM
	default y

config MILLET
	bool "frozen framework"
	depends on MIHW

config XIAOMI_METIS
	bool "dummy xiaomi metis"
	depends on MIHW

config FOCUS_TASK
	bool "set focus task"
	depends on MIHW
```

## techpack/Kconfig
```kconfig
menu "Tech packages"

config TECHPACK_XIAOMI_CAMERA
    bool "Xiaomi techpack camera default"

config TECHPACK_XIAOMI_CAMERA_CAS
    bool "Xiaomi techpack camera cas config"

config TECHPACK_XIAOMI_CAS_PATCH
    bool "Xiaomi techpack cas camera patch"

config TECHPACK_XIAOMI_CAMERA_PSYCHE
    bool "Xiaomi techpack camera config"

source "techpack/data/Kconfig"

endmenu
```
