## drivers/input/fingerprint/fpc_fod/Kconfig
```kconfig
config FINGERPRINT_FPC_FOD
	tristate "FPC1020 fingerprint sensor IRQ support"
	depends on INPUT_FINGERPRINT
```

## drivers/input/fingerprint/fpc_tee/Kconfig
```kconfig
config FINGERPRINT_FPC_TEE
	tristate "Finger print card fpc"
	depends on INPUT_FINGERPRINT
```

## drivers/input/fingerprint/goodix/Kconfig
```kconfig
config FINGERPRINT_GOODIX_TA
	tristate "Finger print card goodix"
	depends on INPUT_FINGERPRINT
```

## drivers/input/fingerprint/goodix_fod/Kconfig
```kconfig
config FINGERPRINT_GOODIX_FOD
	tristate "Finger print card goodix"
	depends on INPUT_FINGERPRINT
```

## drivers/input/fingerprint/goodix_fod_lmi/Kconfig
```kconfig
config FINGERPRINT_GOODIX_FOD_LMI
	tristate "Finger print card goodix"
	depends on INPUT_FINGERPRINT
```

## drivers/input/fingerprint/goodix_fod_thy/Kconfig
```kconfig
config FINGERPRINT_GOODIX_FOD_THY
	tristate "Finger print card goodix"
	depends on INPUT_FINGERPRINT
```
